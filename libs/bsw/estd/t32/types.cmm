// estd::vector
symbol.addinfo.type estd::declare::vector<? TABLE "(#o)._size" "&(#o)._realData"

// Base element expression is a rough equivalent of after_me in estd
symbol.addinfo.type estd::vector<? TABLE "(#o)._size" "(value_type*)(&((&(#o))[1]))"

// estd::array
symbol.addinfo.type estd::array<? TABLE "sizeof((#o)._values)/sizeof((#o)._values[0])" "&(#o)._values"

// estd::slice
symbol.addinfo.type estd::slice<? TABLE "(#o)._size" "(#o)._data"

// estd::optional
symbol.addinfo.type estd::optional<? TABLE "(#o)._value ? 1 : 0" "(value_type*)(&((#o)._value_mem))"
